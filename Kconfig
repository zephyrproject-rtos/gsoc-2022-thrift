## Kconfig
```kconfig
# Copyright 2022 Meta
# SPDX-License-Identifier: Apache-2.0

rsource "lib/thrift/Kconfig"
```

## lib/thrift/Kconfig
```kconfig
# Copyright 2022 Meta
# SPDX-License-Identifier: Apache-2.0

menu "Thrift"

config THRIFT
  bool "Enable support for Thrift"
  depends on CPLUSPLUS
  depends on LIB_CPLUSPLUS
  depends on STD_CPP17
  depends on EXCEPTIONS
  depends on (ARCH_POSIX && !POSIX_API) || (!ARCH_POSIX && POSIX_API)
  depends on (ARCH_POSIX && !EVENTFD) || (!ARCH_POSIX && EVENTFD)
  help
    Enable this option to support Apache Thrift

if THRIFT

config THRIFT_SSL_SOCKET
  bool "Enable TSSLSocket support for Thrift"
  depends on MBEDTLS
  depends on MBEDTLS_PEM_CERTIFICATE_FORMAT
  depends on NET_SOCKETS_SOCKOPT_TLS
  help
    Enable this option to support TSSLSocket for Thrift
    
config THRIFT_ZLIB_TRANSPORT
  bool "Enable TZlibTransport support for Thrift"
  help
    Enable this option to support TZlibTransport for Thrift

endif # THRIFT

endmenu

module = THRIFT
module-str = THRIFT
source "subsys/logging/Kconfig.template.log_config"
```

## tests/lib/thrift/ThriftTest/testcase.yaml
```yaml
common:
  tags: thrift cpp
  # FIXME: zephyrproject-rtos/zephyr#45100
  arch_exclude: posix
  filter: TOOLCHAIN_HAS_NEWLIB == 1
  toolchain_exclude: xcc
  arch_exclude: arc xtensa
  integration_platforms:
    - mps2_an385
    - qemu_cortex_a53
    - qemu_riscv32
    - qemu_riscv64_smp
    - qemu_x86
    - qemu_x86_64
tests:
  thrift.ThriftTest.newlib.binaryProtocol:
    tags: newlib
  thrift.ThriftTest.newlib.compactProtocol:
    extra_configs:
      - CONFIG_THRIFT_COMPACT_PROTOCOL=y
    tags: newlib
  thrift.ThriftTest.newlib.bufferedTransport:
    tags: newlib
  thrift.ThriftTest.newlib.zlibTransport:
    extra_configs:
      - CONFIG_THRIFT_ZLIB_TRANSPORT=y
      - CONFIG_NEWLIB_LIBC_MAX_MAPPED_REGION_SIZE=4194304
    tags: newlib
  thrift.ThriftTest.newlib.tlsTransport:
    extra_configs:
      - CONFIG_THRIFT_SSL_SOCKET=y
      - CONFIG_MBEDTLS=y
      - CONFIG_MBEDTLS_PEM_CERTIFICATE_FORMAT=y
      - CONFIG_MBEDTLS_ENABLE_HEAP=y
      - CONFIG_MBEDTLS_HEAP_SIZE=60000
      - CONFIG_MBEDTLS_SSL_MAX_CONTENT_LEN=2048
      - CONFIG_NET_SOCKETS_TLS_MAX_CONTEXTS=6
      - CONFIG_NET_SOCKETS_SOCKOPT_TLS=y
      - CONFIG_NET_TCP=y
      - CONFIG_NET_SOCKETS=y
      - CONFIG_NET_BUF_TX_COUNT=64
      - CONFIG_NET_PKT_TX_COUNT=64
      - CONFIG_NET_BUF_RX_COUNT=64
      - CONFIG_NET_PKT_RX_COUNT=64
      - CONFIG_POSIX_MAX_FDS=64
    integration_platforms:
      - mps2_an385
    tags: newlib
#  thrift.hello.native:
#    arch_allow: posix
#    tags: native
```

## tests/lib/thrift/hello/testcase.yaml
```yaml
common:
  tags: thrift cpp
  # FIXME: zephyrproject-rtos/zephyr#45100
  arch_exclude: posix
  filter: TOOLCHAIN_HAS_NEWLIB == 1
  toolchain_exclude: xcc
  arch_exclude: arc xtensa
  integration_platforms:
    - mps2_an385
    - qemu_cortex_a53
    - qemu_riscv32
    - qemu_riscv64_smp
    - qemu_x86
    - qemu_x86_64
tests:
  thrift.hello.newlib:
    tags: newlib
#  thrift.hello.native:
#    arch_allow: posix
#    tags: native
```

## tests/lib/thrift/muzic/testcase.yaml
```yaml
common:
  tags: muzic
  # FIXME: zephyrproject-rtos/zephyr#45100
  arch_exclude: posix
  filter: TOOLCHAIN_HAS_NEWLIB == 1
  toolchain_exclude: xcc
  arch_exclude: arc xtensa
  integration_platforms:
    - mps2_an385
    - qemu_cortex_a53
    - qemu_riscv32
    - qemu_riscv64_smp
    - qemu_x86
    - qemu_x86_64
tests:
  muzic.newlib:
    tags: newlib
```

## west.yml
```yaml
manifest:
  self:
    path: thrift-for-zephyr

  remotes:
    - name: zephyrproject-rtos
      url-base: https://github.com/zephyrproject-rtos
    - name: cfriedt
      url-base: https://github.com/cfriedt

  projects:
    # This is actually a submodule of 'self'
    - name: thrift
      remote: cfriedt
      path: thrift-for-zephyr/.upstream
      # corresponds to revision: v0.16.0, but the tag does not exist in cfriedt/thrift
      revision: b455e5d8e245fbe2568bb28093eb1f7f9d65d442
    - name: net-tools
      remote: zephyrproject-rtos
      revision: master
    - name: zephyr
      remote: zephyrproject-rtos
      revision: main
      import: true
```
