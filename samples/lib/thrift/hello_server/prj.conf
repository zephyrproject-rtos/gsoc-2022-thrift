## CMakeLists.txt
```
# Copyright 2022 Meta
# SPDX-License-Identifier: Apache-2.0

cmake_minimum_required(VERSION 3.13.1)
find_package(Zephyr REQUIRED HINTS $ENV{ZEPHYR_BASE})
project(thrift_hello_server)

FILE(GLOB app_sources
    src/*.cpp
)

include(${ZEPHYR_THRIFT_MODULE_DIR}/cmake/thrift.cmake)

set(generated_sources "")
set(gen_dir ${ZEPHYR_BINARY_DIR}/misc/generated/thrift_hello)
list(APPEND generated_sources ${gen_dir}/gen-cpp/hello_types.h)
list(APPEND generated_sources ${gen_dir}/gen-cpp/Hello.cpp)
list(APPEND generated_sources ${gen_dir}/gen-cpp/Hello.h)
list(APPEND app_sources ${generated_sources})

thrift(
    app
    cpp
    :no_skeleton
    ${gen_dir}
    "${ZEPHYR_THRIFT_MODULE_DIR}/thrift/hello.thrift"
    ""
    ${generated_sources}
)

target_sources(app PRIVATE ${app_sources})

# needed because std::iterator was deprecated with -std=c++17
target_compile_options(app PRIVATE -Wno-deprecated-declarations)
```

## Kconfig
```
# SPDX-License-Identifier: Apache-2.0
# Copyright (c) 2022 Meta

source "Kconfig.zephyr"

config THRIFT_COMPACT_PROTOCOL
  bool "Enable TCompactProtocol in samples"
  depends on THRIFT
  help
    Enable this option to use  TCompactProtocol in samples
```

## sample.yaml
```
sample:
  description: Hello Thrift sample
  name: hello thrift
common:
  tags: thrift cpp
  # FIXME: zephyrproject-rtos/zephyr#45100
  arch_exclude: posix
  filter: TOOLCHAIN_HAS_NEWLIB == 1
  toolchain_exclude: xcc
  arch_exclude: arc xtensa
  integration_platforms:
    - mps2_an385
    - qemu_cortex_a53
    - qemu_riscv32
    - qemu_riscv64_smp
    - qemu_x86
    - qemu_x86_64
tests:
  thrift.ThriftTest.newlib.binaryProtocol:
    tags: newlib
  thrift.ThriftTest.newlib.compactProtocol:
    extra_configs:
      - CONFIG_THRIFT_COMPACT_PROTOCOL=y
    tags: newlib
  thrift.ThriftTest.newlib.zlibTransport:
    extra_configs:
      - CONFIG_THRIFT_ZLIB_TRANSPORT=y
    tags: newlib
  thrift.ThriftTest.newlib.tlsTransport:
    extra_args: OVERLAY_CONFIG="../hello_common/overlay-tls.conf"
    tags: newlib
#  thrift.hello.native:
#    arch_allow: posix
#    tags: native
```

## prj.conf
```kconfig
# CONFIG_LIB_CPLUSPLUS Dependencies
CONFIG_NEWLIB_LIBC=y
CONFIG_NEWLIB_LIBC_NANO=n

# CONFIG_THRIFT Dependencies
CONFIG_CPLUSPLUS=y
CONFIG_LIB_CPLUSPLUS=y
CONFIG_STD_CPP17=y
CONFIG_EXCEPTIONS=y
CONFIG_POSIX_API=y
CONFIG_NETWORKING=y
CONFIG_NET_SOCKETS=y
CONFIG_NET_SOCKETPAIR=y
CONFIG_HEAP_MEM_POOL_SIZE=16384
CONFIG_EVENTFD=y

CONFIG_THRIFT=y

CONFIG_TEST_RANDOM_GENERATOR=y
# pthread_cond_wait() triggers sentinel for some reason
CONFIG_STACK_SENTINEL=n

# Generic networking options
CONFIG_NETWORKING=y
CONFIG_NET_UDP=y
CONFIG_NET_TCP=y
CONFIG_NET_IPV6=y
CONFIG_NET_IPV4=y
CONFIG_NET_SOCKETS=y
CONFIG_POSIX_MAX_FDS=6
CONFIG_NET_CONNECTION_MANAGER=y

# Kernel options
CONFIG_MAIN_STACK_SIZE=4096
CONFIG_ENTROPY_GENERATOR=y
CONFIG_TEST_RANDOM_GENERATOR=y
CONFIG_INIT_STACKS=y

# Logging
CONFIG_NET_LOG=y
CONFIG_LOG=y
CONFIG_NET_STATISTICS=y
CONFIG_PRINTK=y

# Network buffers
CONFIG_NET_PKT_RX_COUNT=16
CONFIG_NET_PKT_TX_COUNT=16
CONFIG_NET_BUF_RX_COUNT=64
CONFIG_NET_BUF_TX_COUNT=64
CONFIG_NET_CONTEXT_NET_PKT_POOL=y

# IP address options
CONFIG_NET_IF_UNICAST_IPV6_ADDR_COUNT=3
CONFIG_NET_IF_MCAST_IPV6_ADDR_COUNT=4
CONFIG_NET_MAX_CONTEXTS=10

# Network shell
CONFIG_NET_SHELL=y
CONFIG_SHELL=y

# Network application options and configuration
CONFIG_NET_CONFIG_SETTINGS=y
CONFIG_NET_CONFIG_NEED_IPV6=y
CONFIG_NET_CONFIG_MY_IPV6_ADDR="2001:db8::1"
CONFIG_NET_CONFIG_PEER_IPV6_ADDR="2001:db8::2"
CONFIG_NET_CONFIG_NEED_IPV4=y
CONFIG_NET_CONFIG_MY_IPV4_ADDR="192.0.2.1"
CONFIG_NET_CONFIG_PEER_IPV4_ADDR="192.0.2.2"

# Number of socket descriptors might need adjusting
# if there are more than 1 handlers defined.
CONFIG_POSIX_MAX_FDS=12
```

## boards/qemu_x86_64.conf
```kconfig
CONFIG_NET_QEMU_USER=y
CONFIG_NET_QEMU_USER_EXTRA_ARGS="net=192.168.0.0/24,hostfwd=tcp::4242-:4242"
CONFIG_PCIE=y
CONFIG_NET_L2_ETHERNET=y
CONFIG_ETH_E1000=y
CONFIG_NET_TCP=y
CONFIG_NET_IPV4=y
CONFIG_NET_IPV6=n

# Network buffers
CONFIG_NET_PKT_RX_COUNT=16
CONFIG_NET_PKT_TX_COUNT=16
CONFIG_NET_BUF_RX_COUNT=64
CONFIG_NET_BUF_TX_COUNT=64
CONFIG_NET_CONTEXT_NET_PKT_POOL=y

# IP address options
CONFIG_NET_MAX_CONTEXTS=10

# Network shell
CONFIG_NET_SHELL=y
CONFIG_SHELL=y

# Network application options and configuration
CONFIG_NET_CONFIG_SETTINGS=y
CONFIG_NET_CONFIG_NEED_IPV4=y
CONFIG_NET_CONFIG_MY_IPV4_ADDR="192.0.2.1"
CONFIG_NET_CONFIG_PEER_IPV4_ADDR="192.0.2.2"
CONFIG_NET_CONFIG_AUTO_INIT=y

# Number of socket descriptors might need adjusting
# if there are more than 1 handlers defined.
CONFIG_POSIX_MAX_FDS=12
```

## src/main.cpp
```c
/*
 * Copyright 2022 Meta
 *
 * SPDX-License-Identifier: Apache-2.0
 */

#ifdef __ZEPHYR__
#include <zephyr/kernel.h>
#endif

#include <cstdio>
#include <cstdlib>

#include <thrift/protocol/TBinaryProtocol.h>
#include <thrift/protocol/TCompactProtocol.h>
#include <thrift/server/TSimpleServer.h>
#include <thrift/transport/TBufferTransports.h>
#include <thrift/transport/TSSLServerSocket.h>
#include <thrift/transport/TSSLSocket.h>
#include <thrift/transport/TServerSocket.h>
#include <thrift/transport/TZlibTransport.h>

#include "Hello.h"
#include "HelloHandler.h"

using namespace ::apache::thrift;
using namespace ::apache::thrift::protocol;
using namespace ::apache::thrift::transport;
using namespace ::apache::thrift::server;

#ifndef IS_ENABLED
#define IS_ENABLED(flag) flag
#endif

#ifndef CONFIG_THRIFT_COMPACT_PROTOCOL
#define CONFIG_THRIFT_COMPACT_PROTOCOL 0
#endif

#ifndef CONFIG_THRIFT_ZLIB_TRANSPORT
#define CONFIG_THRIFT_ZLIB_TRANSPORT 0
#endif

#ifndef CONFIG_THRIFT_SSL_SOCKET
#define CONFIG_THRIFT_SSL_SOCKET 0
#endif

#ifdef __ZEPHYR__
int main(void)
#else
int main(int argc, char** argv)
#endif
{
  std::string my_addr;

#ifdef __ZEPHYR__
  my_addr = CONFIG_NET_CONFIG_MY_IPV4_ADDR;
#else
  if (argc < 2) {
    printf("usage: %s <ip>\n", argv[0]);
    return EXIT_FAILURE;
  }

  my_addr = std::string(argv[1]);
#endif

  int port = 4242;
  std::shared_ptr<HelloHandler> handler(new HelloHandler());
  std::shared_ptr<TProcessor> processor(new HelloProcessor(handler));
  std::shared_ptr<TServerTransport> serverTransport;
  if (IS_ENABLED(CONFIG_THRIFT_SSL_SOCKET)) {
    const int port = 4242;
    std::shared_ptr<TSSLSocketFactory> socketFactory(new TSSLSocketFactory());
    socketFactory->server(true);
#ifdef __ZEPHYR__
    socketFactory->loadCertificateFromBuffer(
#include "../../hello_common/qemu-cert.pem"
    );
    socketFactory->loadPrivateKeyFromBuffer(
#include "../../hello_common/qemu-key.pem"
    );
    socketFactory->loadTrustedCertificatesFromBuffer(
#include "../../hello_common/native-cert.pem"
    );
#else
    socketFactory->loadCertificateFromBuffer(
#include "../../hello_common/native-cert.pem"
    );
    socketFactory->loadPrivateKeyFromBuffer(
#include "../../hello_common/native-key.pem"
    );
    socketFactory->loadTrustedCertificatesFromBuffer(
#include "../../hello_common/qemu-cert.pem"
    );
#endif
    serverTransport = std::make_shared<TSSLServerSocket>("0.0.0.0", port, socketFactory);
  } else {
    serverTransport = std::make_shared<TServerSocket>(my_addr, port);
  }
  std::shared_ptr<TTransportFactory> transportFactory;
  if (IS_ENABLED(CONFIG_THRIFT_ZLIB_TRANSPORT)) {
    transportFactory = std::make_shared<TZlibTransportFactory>();
  } else {
    transportFactory = std::make_shared<TBufferedTransportFactory>();
  }
  std::shared_ptr<TProtocolFactory> protocolFactory;
  if (IS_ENABLED(CONFIG_THRIFT_COMPACT_PROTOCOL)) {
    protocolFactory = std::make_shared<TCompactProtocolFactory>();
  } else {
    protocolFactory = std::make_shared<TBinaryProtocolFactory>();
  }
  TSimpleServer server(processor, serverTransport, transportFactory, protocolFactory);

  try {
    server.serve();
  } catch (std::exception& e) {
    printf("caught exception: %s\n", e.what());
    return EXIT_FAILURE;
  }

  return EXIT_SUCCESS;
}
```

## src/HelloHandler.h
```c
/*
 * Copyright 2022 Meta
 *
 * SPDX-License-Identifier: Apache-2.0
 */

#pragma once

#ifdef __ZEPHYR__
#include <zephyr/kernel.h>
#else
#define printk printf
#endif

#include <iostream>

#include "Hello.h"

class HelloHandler : virtual public HelloIf {
public:
  HelloHandler() : count(0) {}

  void ping() { printk("ping\n"); }

  void echo(std::string& _return, const std::string& msg) {
    printk("echo: %s\n", msg.c_str());
    _return = msg;
  }

  int32_t counter() {
    ++count;
    printk("counter: %d\n", count);
    return count;
  }

protected:
  int count;
};
```
