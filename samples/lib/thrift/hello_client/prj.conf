## CMakeLists.txt
```
# Copyright 2022 Meta
# SPDX-License-Identifier: Apache-2.0

cmake_minimum_required(VERSION 3.13.1)
find_package(Zephyr REQUIRED HINTS $ENV{ZEPHYR_BASE})
project(thrift_hello_server)

FILE(GLOB app_sources
    src/*.cpp
)

include(${CMAKE_CURRENT_SOURCE_DIR}/../../../../cmake/thrift.cmake)

set(generated_sources "")
set(gen_dir ${ZEPHYR_BINARY_DIR}/misc/generated/thrift_hello)
list(APPEND generated_sources ${gen_dir}/gen-cpp/hello_types.h)
list(APPEND generated_sources ${gen_dir}/gen-cpp/Hello.cpp)
list(APPEND generated_sources ${gen_dir}/gen-cpp/Hello.h)
list(APPEND app_sources ${generated_sources})

thrift(
    app
    cpp
    :no_skeleton
    ${gen_dir}
    # FIXME: is there a variable that can be used here to refer to the module root?
    "${CMAKE_CURRENT_SOURCE_DIR}/../../../../thrift/hello.thrift"
    ""
    ${generated_sources}
)

target_sources(app PRIVATE ${app_sources})
```

## sample.yaml
```
sample:
  description: Hello Thrift client sample
  name: hello thrift client
common:
  tags: thrift cpp sample
tests:
  sample.thrift.hello.client.binaryProtocol:
    platform_allow: mps2_an385 qemu_cortex_a53 qemu_x86_64 qemu_riscv32 qemu_riscv64_smp
    integration_platforms:
      - qemu_x86_64
  sample.thrift.hello.client.compactProtocol:
    extra_configs:
      - CONFIG_THRIFT_COMPACT_PROTOCOL=y
    platform_allow: mps2_an385 qemu_cortex_a53 qemu_x86_64 qemu_riscv32 qemu_riscv64_smp
    integration_platforms:
      - qemu_x86_64
  sample.thrift.hello.client.zlibTransport:
    extra_configs:
      - CONFIG_THRIFT_ZLIB_TRANSPORT=y
    platform_allow: mps2_an385 qemu_cortex_a53 qemu_x86_64 qemu_riscv32 qemu_riscv64_smp
    integration_platforms:
      - qemu_x86_64
  sample.thrift.hello.client.tlsTransport:
    extra_args: OVERLAY_CONFIG="../hello_common/overlay-tls.conf"
    platform_allow: mps2_an385 qemu_cortex_a53 qemu_x86_64 qemu_riscv32 qemu_riscv64_smp
    integration_platforms:
      - qemu_x86_64
```

## prj.conf
```kconfig
# CONFIG_LIB_CPLUSPLUS Dependencies
CONFIG_NEWLIB_LIBC=y
CONFIG_NEWLIB_LIBC_NANO=n

# CONFIG_THRIFT Dependencies
CONFIG_CPLUSPLUS=y
CONFIG_LIB_CPLUSPLUS=y
CONFIG_STD_CPP17=y
CONFIG_EXCEPTIONS=y
CONFIG_POSIX_API=y
CONFIG_NETWORKING=y
CONFIG_NET_SOCKETS=y
CONFIG_NET_SOCKETPAIR=y
CONFIG_HEAP_MEM_POOL_SIZE=16384
CONFIG_EVENTFD=y

CONFIG_THRIFT=y

CONFIG_TEST_RANDOM_GENERATOR=y
# pthread_cond_wait() triggers sentinel for some reason
CONFIG_STACK_SENTINEL=n

# Generic networking options
CONFIG_NETWORKING=y
CONFIG_NET_UDP=y
CONFIG_NET_TCP=y
CONFIG_NET_IPV6=y
CONFIG_NET_IPV4=y
CONFIG_NET_SOCKETS=y
CONFIG_POSIX_MAX_FDS=6
CONFIG_NET_CONNECTION_MANAGER=y

# Kernel options
CONFIG_ENTROPY_GENERATOR=y
CONFIG_TEST_RANDOM_GENERATOR=y
CONFIG_INIT_STACKS=y

# Logging
CONFIG_NET_LOG=y
CONFIG_LOG=y
CONFIG_NET_STATISTICS=y
CONFIG_PRINTK=y

# Network buffers
CONFIG_NET_PKT_RX_COUNT=16
CONFIG_NET_PKT_TX_COUNT=16
CONFIG_NET_BUF_RX_COUNT=64
CONFIG_NET_BUF_TX_COUNT=64
CONFIG_NET_CONTEXT_NET_PKT_POOL=y

# IP address options
CONFIG_NET_IF_UNICAST_IPV6_ADDR_COUNT=3
CONFIG_NET_IF_MCAST_IPV6_ADDR_COUNT=4
CONFIG_NET_MAX_CONTEXTS=10

# Network application options and configuration
CONFIG_NET_CONFIG_SETTINGS=y
CONFIG_NET_CONFIG_NEED_IPV6=y
CONFIG_NET_CONFIG_MY_IPV6_ADDR="2001:db8::1"
CONFIG_NET_CONFIG_PEER_IPV6_ADDR="2001:db8::2"
CONFIG_NET_CONFIG_NEED_IPV4=y
CONFIG_NET_CONFIG_MY_IPV4_ADDR="192.0.2.1"
CONFIG_NET_CONFIG_PEER_IPV4_ADDR="192.0.2.2"

# Number of socket descriptors might need adjusting
# if there are more than 1 handlers defined.
CONFIG_POSIX_MAX_FDS=16

# default stack sizes are not enough
CONFIG_MAIN_STACK_SIZE=8192
CONFIG_SYSTEM_WORKQUEUE_STACK_SIZE=8192
CONFIG_NET_TCP_WORKQ_STACK_SIZE=4096
CONFIG_NET_MGMT_EVENT_STACK_SIZE=4096
CONFIG_IDLE_STACK_SIZE=4096
CONFIG_NET_RX_STACK_SIZE=8192
```

## src/main.cpp
```c
/*
 * Copyright 2022 Meta
 *
 * SPDX-License-Identifier: Apache-2.0
 */

#ifdef __ZEPHYR__
#include <zephyr/kernel.h>
#endif

#include <cstdlib>
#include <iostream>

#include <fcntl.h>

#include <thrift/protocol/TBinaryProtocol.h>
#include <thrift/protocol/TCompactProtocol.h>
#include <thrift/transport/TBufferTransports.h>
#include <thrift/transport/TSSLSocket.h>
#include <thrift/transport/TSocket.h>
#include <thrift/transport/TZlibTransport.h>

#include "Hello.h"

using namespace apache::thrift;
using namespace apache::thrift::protocol;
using namespace apache::thrift::transport;

#ifndef IS_ENABLED
#define IS_ENABLED(flag) flag
#endif

#ifndef CONFIG_THRIFT_COMPACT_PROTOCOL
#define CONFIG_THRIFT_COMPACT_PROTOCOL 0
#endif

#ifndef CONFIG_THRIFT_ZLIB_TRANSPORT
#define CONFIG_THRIFT_ZLIB_TRANSPORT 0
#endif

#ifndef CONFIG_THRIFT_SSL_SOCKET
#define CONFIG_THRIFT_SSL_SOCKET 0
#endif

#ifdef __ZEPHYR__
int main(void)
#else
int main(int argc, char** argv)
#endif
{
  std::string my_addr;

#ifdef __ZEPHYR__
  my_addr = CONFIG_NET_CONFIG_PEER_IPV4_ADDR;
#else
  if (argc >= 2) {
    my_addr = std::string(argv[1]);
  } else {
    my_addr = "192.0.2.1";
  }
#endif

  int port = 4242;
  std::shared_ptr<TSSLSocketFactory> socketFactory;
  std::shared_ptr<TTransport> trans;
  if (IS_ENABLED(CONFIG_THRIFT_SSL_SOCKET)) {
    const int port = 4242;
    socketFactory = std::make_shared<TSSLSocketFactory>();
    socketFactory->authenticate(true);
#ifdef __ZEPHYR__
    socketFactory->loadCertificateFromBuffer(
#include "../../hello_common/qemu-cert.pem"
    );
    socketFactory->loadPrivateKeyFromBuffer(
#include "../../hello_common/qemu-key.pem"
    );
    socketFactory->loadTrustedCertificatesFromBuffer(
#include "../../hello_common/native-cert.pem"
    );
#else
    socketFactory->loadCertificateFromBuffer(
#include "../../hello_common/native-cert.pem"
    );
    socketFactory->loadPrivateKeyFromBuffer(
#include "../../hello_common/native-key.pem"
    );
    socketFactory->loadTrustedCertificatesFromBuffer(
#include "../../hello_common/qemu-cert.pem"
    );
#endif
    trans = socketFactory->createSocket(my_addr, port);
  } else {
    trans = std::make_shared<TSocket>(my_addr, port);
  }
  std::shared_ptr<TTransport> transport;
  if (IS_ENABLED(CONFIG_THRIFT_ZLIB_TRANSPORT)) {
    transport = std::make_shared<TZlibTransport>(trans);
  } else {
    transport = std::make_shared<TBufferedTransport>(trans);
  }
  std::shared_ptr<TProtocol> protocol;
  if (IS_ENABLED(CONFIG_THRIFT_COMPACT_PROTOCOL)) {
    protocol = std::make_shared<TCompactProtocol>(transport);
  } else {
    protocol = std::make_shared<TBinaryProtocol>(transport);
  }
  HelloClient client(protocol);

  try {
    transport->open();
    client.ping();
    std::string s;
    client.echo(s, "Hello, world!");
    for (int i = 0; i < 5; ++i) {
      client.counter();
    }
    transport->close();
  } catch (std::exception& e) {
    printf("caught exception: %s\n", e.what());
    return EXIT_FAILURE;
  }

  return EXIT_SUCCESS;
}
```
