## CMakeLists.txt
```
# Copyright 2022 Meta
# SPDX-License-Identifier: Apache-2.0

cmake_minimum_required(VERSION 3.13.1)
find_package(Zephyr REQUIRED HINTS $ENV{ZEPHYR_BASE})
project(thrift_hello)

include(${ZEPHYR_THRIFT_MODULE_DIR}/cmake/thrift.cmake)

FILE(GLOB app_sources
    src/*.cpp
    src/thrift/server/*.cpp
)

set(generated_sources "")
set(gen_dir ${ZEPHYR_BINARY_DIR}/misc/generated/thrift_hello)
list(APPEND generated_sources ${gen_dir}/gen-cpp/hello_types.h)
list(APPEND generated_sources ${gen_dir}/gen-cpp/Hello.cpp)
list(APPEND generated_sources ${gen_dir}/gen-cpp/Hello.h)
list(APPEND app_sources ${generated_sources})

thrift(
    app
    cpp
    :no_skeleton
    ${gen_dir}
    "${ZEPHYR_THRIFT_MODULE_DIR}/thrift/hello.thrift"
    ""
    ${generated_sources}
)

target_sources(app PRIVATE ${app_sources})

# needed because std::iterator was deprecated with -std=c++17
target_compile_options(app PRIVATE -Wno-deprecated-declarations)
```

## prj.conf
```kconfig
# CONFIG_LIB_CPLUSPLUS Dependencies
CONFIG_NEWLIB_LIBC=y
CONFIG_NEWLIB_LIBC_NANO=n

# CONFIG_THRIFT Dependencies
CONFIG_CPLUSPLUS=y
CONFIG_LIB_CPLUSPLUS=y
CONFIG_STD_CPP17=y
CONFIG_EXCEPTIONS=y
CONFIG_POSIX_API=y
CONFIG_NETWORKING=y
CONFIG_NET_SOCKETS=y
CONFIG_NET_SOCKETPAIR=y
CONFIG_HEAP_MEM_POOL_SIZE=16384
CONFIG_EVENTFD=y

CONFIG_THRIFT=y

# Test dependencies
CONFIG_ZTEST=y
CONFIG_TEST_RANDOM_GENERATOR=y
CONFIG_NET_TEST=y
CONFIG_NET_DRIVERS=y
CONFIG_NET_LOOPBACK=y
# pthread_cond_wait() triggers sentinel for some reason
CONFIG_STACK_SENTINEL=n

# qemu_riscv64_smp can overflow stacks due to PMP gaurd
CONFIG_SYSTEM_WORKQUEUE_STACK_SIZE=4096
CONFIG_ZTEST_STACK_SIZE=2048
```

## boards/qemu_x86_64.conf
```kconfig
CONFIG_NET_QEMU_USER=y
CONFIG_NET_QEMU_USER_EXTRA_ARGS="net=192.168.0.0/24,hostfwd=tcp::4242-:4242"
CONFIG_PCIE=y
CONFIG_NET_L2_ETHERNET=y
CONFIG_ETH_E1000=y
```

## src/main.cpp
```c
/*
 * Copyright 2022 Meta
 *
 * SPDX-License-Identifier: Apache-2.0
 */

#include <zephyr/ztest.h>

#include <array>
#include <memory>
#include <stdexcept>

#include <pthread.h>
#include <signal.h>
#include <sys/socket.h>
#include <unistd.h>

#include "Hello.h"
#include "HelloHandler.h"
#include "thrift/server/TFDServer.h"

#include <thrift/protocol/TBinaryProtocol.h>
#include <thrift/server/TSimpleServer.h>
#include <thrift/transport/TBufferTransports.h>
#include <thrift/transport/TFDTransport.h>
#include <thrift/transport/TServerSocket.h>

using namespace std;
using namespace ::apache::thrift;
using namespace ::apache::thrift::protocol;
using namespace ::apache::thrift::transport;
using namespace ::apache::thrift::server;

#define HELLO_SERVER_STACK_SIZE 8192
static K_THREAD_STACK_DEFINE(hello_server_stack, HELLO_SERVER_STACK_SIZE);

struct ctx {
  enum {
    SERVER,
    CLIENT,
  };

  std::array<int, CLIENT + 1> fds;
  std::shared_ptr<HelloClient> client;
  std::shared_ptr<TServer> server;
  pthread_t server_thread;
};

static ctx context;

static void* server_func(void* arg) {
  (void)arg;

  try {
    context.server->serve();
  } catch (...) {
  }

  return nullptr;
}

static std::shared_ptr<HelloClient> setup_client() {
  std::shared_ptr<TTransport> trans(new TFDTransport(context.fds[ctx::CLIENT]));
  std::shared_ptr<TTransport> transport(new TBufferedTransport(trans));
  std::shared_ptr<TProtocol> protocol(new TBinaryProtocol(transport));
  transport->open();
  return std::make_shared<HelloClient>(protocol);
}

std::shared_ptr<TServer> setup_server() {
  std::shared_ptr<HelloHandler> handler(new HelloHandler());
  std::shared_ptr<TProcessor> processor(new HelloProcessor(handler));
  std::shared_ptr<TServerTransport> serverTransport(new TFDServer(context.fds[ctx::SERVER]));
  std::shared_ptr<TTransportFactory> transportFactory(new TBufferedTransportFactory());
  std::shared_ptr<TProtocolFactory> protocolFactory(new TBinaryProtocolFactory());
  TSimpleServer server(processor, serverTransport, transportFactory, protocolFactory);
  return std::shared_ptr<TServer>(
      new TSimpleServer(processor, serverTransport, transportFactory, protocolFactory));
}

static void setup(void) {
  int rv;
  pthread_attr_t attr;
  pthread_attr_t* attrp = &attr;

  if (IS_ENABLED(CONFIG_ARCH_POSIX)) {
    attrp = NULL;
  } else {
    rv = pthread_attr_init(attrp);
    zassert_equal(0, rv, "pthread_attr_init failed: %d", rv);
    rv = pthread_attr_setstack(attrp, hello_server_stack, HELLO_SERVER_STACK_SIZE);
    zassert_equal(0, rv, "pthread_attr_setstack failed: %d", rv);
  }

  // create the communication channel
  rv = socketpair(AF_UNIX, SOCK_STREAM, 0, &context.fds.front());
  zassert_equal(0, rv, "socketpair failed: %d", rv);

  // set up server
  context.server = setup_server();

  // set up client
  context.client = setup_client();

  // start the server
  rv = pthread_create(&context.server_thread, attrp, server_func, nullptr);
  zassert_equal(0, rv, "pthread_create failed: %d", rv);
}

static void teardown(void) {
  void* unused;

  try {
    context.server->stop();
  } catch (...) {
  }

  zassert_ok(pthread_join(context.server_thread, &unused), "");

  context.client = nullptr;
  context.server = nullptr;

  for (auto& fd : context.fds) {
    close(fd);
  }
}

static void test_ping(void) {
  context.client->ping();
}

static void test_hello(void) {
  string s;

  context.client->echo(s, "Hello, world!");
  zassert_equal(s, "Hello, world!", "");
}

static void test_counter(void) {
  for (int i = 1; i <= 5; ++i) {
    zassert_equal(i, context.client->counter(), "");
  }
}

void test_main(void) {

  ztest_test_suite(thrift_hello, ztest_unit_test_setup_teardown(test_ping, setup, teardown),
                   ztest_unit_test_setup_teardown(test_hello, setup, teardown),
                   ztest_unit_test_setup_teardown(test_counter, setup, teardown));
  ztest_run_test_suite(thrift_hello);
}
```

## src/HelloHandler.h
```c
/*
 * Copyright 2022 Meta
 *
 * SPDX-License-Identifier: Apache-2.0
 */

#pragma once

#include <iostream>

#include "Hello.h"

class HelloHandler : virtual public HelloIf {
public:
  HelloHandler() : count(0) {}

  void ping() { printk("ping\n"); }

  void echo(std::string& _return, const std::string& msg) {
    printk("echo: %s\n", msg.c_str());
    _return = msg;
  }

  int32_t counter() {
    ++count;
    printk("counter: %d\n", count);
    return count;
  }

protected:
  int count;
};
```
